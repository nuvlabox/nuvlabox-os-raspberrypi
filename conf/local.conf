## conf/local.conf
```bitbake
# For more info on how to configure this file, check
# https://git.yoctoproject.org/cgit/cgit.cgi/poky/tree/meta-poky/conf/local.conf.sample

#
# Machine Selection
#
#MACHINE ?= "raspberrypi"
#MACHINE ?= "raspberrypi2"
#MACHINE ?= "raspberrypi3"
#MACHINE ?= "revpi-core-3"
#MACHINE ?= "raspberrypi4-64"

# This sets the default machine if no other machine is selected:
MACHINE ??= "raspberrypi3"


# Where to place downloads
#DL_DIR ?= "${TOPDIR}/downloads"

# Where to place shared-state files
#SSTATE_DIR ?= "${TOPDIR}/sstate-cache"

# Where to place the build output
#TMPDIR = "${TOPDIR}/tmp"


# Default policy config
#
# The distribution setting controls which policy settings are used as defaults.
# The default value is fine for general Yocto project use, at least initially.
# Ultimately when creating custom policy, people will likely end up subclassing 
# these defaults.
#
DISTRO ?= "poky"
# As an example of a subclass there is a "bleeding" edge policy configuration
# where many versions are set to the absolute latest code from the upstream 
# source control systems. This is just mentioned here as an example, its not
# useful to most new users.
# DISTRO ?= "poky-bleeding"


# Package Management configuration
#
# This variable lists which packaging formats to enable. Multiple package backends
# can be enabled at once and the first item listed in the variable will be used
# to generate the root filesystems.
# Options are:
#  - 'package_deb' for debian style deb files
#  - 'package_ipk' for ipk files are used by opkg (a debian style embedded package manager)
#  - 'package_rpm' for rpm style packages
PACKAGE_CLASSES ?= "package_rpm package_deb"


# SDK target architecture
# Supported values are i686 and x86_64
#SDKMACHINE ?= "i686"


# Extra image configuration defaults
#
# The EXTRA_IMAGE_FEATURES variable allows extra packages to be added to the generated
# images. Some of these options are added to certain image types automatically. The
# variable can contain the following options:
#  "dbg-pkgs"       - add -dbg packages for all installed packages
#                     (adds symbol information for debugging/profiling)
#  "src-pkgs"       - add -src packages for all installed packages
#                     (adds source code for debugging)
#  "dev-pkgs"       - add -dev packages for all installed packages
#                     (useful if you want to develop against libs in the image)
#  "ptest-pkgs"     - add -ptest packages for all ptest-enabled packages
#                     (useful if you want to run the package test suites)
#  "tools-sdk"      - add development tools (gcc, make, pkgconfig etc.)
#  "tools-debug"    - add debugging tools (gdb, strace)
#  "eclipse-debug"  - add Eclipse remote debugging support
#  "tools-profile"  - add profiling tools (oprofile, lttng, valgrind)
#  "tools-testapps" - add useful testing tools (ts_print, aplay, arecord etc.)
#  "debug-tweaks"   - make an image suitable for development
#                     e.g. ssh root access has a blank password
# There are other application targets that can be used here too, see
# meta/classes/image.bbclass and meta/classes/core-image.bbclass for more details.
# Example in https://git.yoctoproject.org/cgit/cgit.cgi/poky/tree/meta/classes/image.bbclass#n36
# "read-only-rootfs stateless-rootfs empty-root-password allow-empty-password allow-root-login post-install-logging"
EXTRA_IMAGE_FEATURES ?= "debug-tweaks ssh-server-openssh"


# Additional image features
USER_CLASSES ?= "buildstats image-mklibs image-prelink"


# Runtime testing of images
#IMAGE_CLASSES += "testimage testsdk"
#TESTIMAGE_AUTO_qemuall = "1"


# Interactive shell configuration
#OE_TERMINAL = "auto"
# By default disable interactive patch resolution (tasks will just fail instead):
PATCHRESOLVE = "noop"


# Disk Space Monitoring during the build
BB_DISKMON_DIRS ??= "\
    STOPTASKS,${TMPDIR},1G,100K \
    STOPTASKS,${DL_DIR},1G,100K \
    STOPTASKS,${SSTATE_DIR},1G,100K \
    STOPTASKS,/tmp,100M,100K \
    ABORT,${TMPDIR},100M,1K \
    ABORT,${DL_DIR},100M,1K \
    ABORT,${SSTATE_DIR},100M,1K \
    ABORT,/tmp,10M,1K"


# Shared-state files from other locations
#SSTATE_MIRRORS ?= "\
#file://.* http://someserver.tld/share/sstate/PATH;downloadfilename=PATH \n \
#file://.* file:///some/local/dir/sstate/PATH"


# Yocto Project SState Mirror
#SSTATE_MIRRORS ?= "file://.* http://sstate.yoctoproject.org/2.5/PATH;downloadfilename=PATH"


# Qemu configuration
#PACKAGECONFIG_append_pn-qemu-system-native = " sdl"
#ASSUME_PROVIDED += "libsdl2-native"
#PACKAGECONFIG_append_pn-qemu-system-native = " gtk+"


# Hash Equivalence
#BB_HASHSERVE = "auto"
#BB_SIGNATURE_HANDLER = "OEEquivHash"


# CONF_VERSION
CONF_VERSION = "1"


# When u-boot is enabled we need to use the "Image" format and the "booti", so let's leave it by default
KERNEL_IMAGETYPE="zImage"
KERNEL_BOOTCMD="bootz"	KERNEL_BOOTCMD="bootz"



# disable VC4 graphics for all
DISABLE_VC4GRAPHICS = "1"


# Parallelism Options
BB_NUMBER_THREADS ?= "${@oe.utils.cpu_count()}"
PARALLEL_MAKE ?= "-j ${@oe.utils.cpu_count()}"


# Remove the old image before the new one is generated to save disk space when RM_OLD_IMAGE is set to 1
#RM_OLD_IMAGE = "1"


#
# from the meta-raspberrypi layer, explained at
# http://git.yoctoproject.org/cgit/cgit.cgi/meta-raspberrypi/tree/docs/extra-build-config.md
#


# RPi GPU memory settings
GPU_MEM = "16"


# enable support for the video camera
VIDEO_CAMERA = "1"


# disable RPi boot logo
DISABLE_RPI_BOOT_LOGO = "1"


# To have u-boot load kernel image
RPI_USE_U_BOOT = "1"


# enable the SPI bus:
ENABLE_SPI_BUS = "1"


# enable I2C
ENABLE_I2C = "1"


# RaspberryPi 0, 1, 2 and CM will have UART console enabled by default.
# RaspberryPi 0 WiFi and 3 does not have the UART enabled by default because this
# needs a fixed core frequency and enable_uart wil set it to the minimum. Certain
# operations - 60fps h264 decode, high quality deinterlace - which aren't
# performed on the ARM may be affected, and we wouldn't want to do that to users
# who don't want to use the serial port. Users who want serial console support on
# RaspberryPi 0 Wifi or 3 will have to explicitly set in local.conf:
ENABLE_UART = "1"


# Enable USB Peripheral (Gadget) support
ENABLE_DWC2_PERIPHERAL = "1"


# Enable Openlabs 802.15.4 radio module. set this variable to enable the 802.15.4 hat
ENABLE_AT86RF = "1"


# Enable CAN with Pican2
#ENABLE_SPI_BUS = "1"
ENABLE_CAN = "1"



#
# NuvlaBox specific
#

# remove x11 distro and consider virtualization distro from meta-virtualization
DISTRO_FEATURES_append = " systemd virtualization"
DISTRO_FEATURES_remove = "x11 wayland"
DISTRO_FEATURES_BACKFILL_CONSIDERED = "sysvinit"

# default to systemd
VIRTUAL-RUNTIME_init_manager = "systemd"
VIRTUAL-RUNTIME_initscripts = "systemd-compat-units"

# install docker-ce
IMAGE_INSTALL_append = " docker-ce"
```
